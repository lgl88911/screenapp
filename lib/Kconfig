## lib/Kconfig
```kconfig
# Copyright (c) 2024 Frank
# SPDX-License-Identifier: Apache-2.0

menu "libraries"

rsource "lcd/Kconfig"

endmenu
```

## lib/lcd/Kconfig
```kconfig
# Copyright (c) 2024, Frank
# SPDX-License-Identifier: Apache-2.0

config LCD
	bool "Support extern lcd"
	help
	  This option enables the 'lcd' library
```

## west.yml
```yaml
# Copyright (c) 2024 Frank Li
# SPDX-License-Identifier: Apache-2.0

manifest:
  self:
    west-commands: scripts/west-commands.yml

  remotes:
    - name: zephyrproject-rtos
      url-base: https://github.com/zephyrproject-rtos

  projects:
    - name: zephyr
      remote: zephyrproject-rtos
      revision: v3.7.0
      import:
        # By using name-allowlist we can clone only the modules that are
        # strictly needed by the application.
        name-allowlist:
          - cmsis      # required by the ARM port
          - hal_nxp    # required by the mm_micro board (NXP based)
          - fatfs
          - littlefs
```
