## CMakeLists.txt
```
#-------------------------------------------------------------------------------
# Zephyr Example Application
#
# Copyright (c) 2024 Frank Li
# SPDX-License-Identifier: Apache-2.0

cmake_minimum_required(VERSION 3.13.1)
find_package(Zephyr REQUIRED HINTS $ENV{ZEPHYR_BASE})

project(app LANGUAGES C)

target_sources(app PRIVATE src/main.c)
```

## Kconfig
```
# Copyright (c) 2024 Frank
# SPDX-License-Identifier: Apache-2.0
#
# This file is the application Kconfig entry point. All application Kconfig
# options can be defined here or included via other application Kconfig files.
# You can browse these options using the west targets menuconfig (terminal) or
# guiconfig (GUI).

menu "Zephyr"
source "Kconfig.zephyr"
endmenu

module = APP
module-str = APP
source "subsys/logging/Kconfig.template.log_config"
```

## sample.yaml
```
# This file is provided so that the application can be compiled using Twister,
# the Zephyr testing tool. In this file, multiple combinations can be specified,
# so that you can easily test all of them locally or in CI.
sample:
  description: screen app
  name: screenapp 
common:
  build_only: true
  integration_platforms:
    - mm_micro
tests:
  app.default: {}
  app.debug:
    extra_overlay_confs:
      - debug.conf
```

## prj.conf
```kconfig
CONFIG_SHELL=y
CONFIG_SHELL_CMD_BUFF_SIZE=8192
CONFIG_SHELL_LOG_LEVEL_INF=y
CONFIG_SHELL_STACK_SIZE=4096

CONFIG_HEAP_MEM_POOL_SIZE=102400
CONFIG_FILE_SYSTEM_SHELL=y

CONFIG_DISK_ACCESS=y
CONFIG_FAT_FILESYSTEM_ELM=y

CONFIG_LLEXT=y
CONFIG_LLEXT_LOG_LEVEL_DBG=y
CONFIG_LLEXT_HEAP_SIZE=8
CONFIG_LLEXT_SHELL=y

CONFIG_MAIN_STACK_SIZE=4096

CONFIG_LCD=y
CONFIG_DISPLAY=y

CONFIG_LOG=y
CONFIG_LOG_BUFFER_SIZE=65536
#CONFIG_DISPLAY_LOG_LEVEL_DBG=y
CONFIG_SPI_LOG_LEVEL_DBG=y

CONFIG_COMPILER_SAVE_TEMPS=y
```

## debug.conf
```kconfig
# Copyright (c) 2024 Frank Li
# SPDX-License-Identifier: Apache-2.0
#
# This is a Kconfig fragment which can be used to enable debug-related options
# in the application. See the README for more details.

# compiler
CONFIG_DEBUG_OPTIMIZATIONS=y

# logging
CONFIG_LOG=y
CONFIG_APP_LOG_LEVEL_DBG=y
```

## src/main.c
```c
/*
 * Copyright (c) 2024 Frank Li
 * SPDX-License-Identifier: Apache-2.0
 */

#include <zephyr/kernel.h>
#include <zephyr/logging/log.h>
#include <app/lib/lcd.h>

#include <app_version.h>

LOG_MODULE_REGISTER(main, CONFIG_APP_LOG_LEVEL);



int main(void)
{
	printk("Startup\r\n");
	lcd_init();
	lcd_test();
	while (1) {
		k_sleep(K_MSEC(100));
	}

	return 0;
}
```
